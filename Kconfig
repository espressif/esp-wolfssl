## Kconfig
```kconfig
menu "wolfSSL"

    config TLS_STACK_WOLFSSL
        bool "Include wolfSSL in ESP-TLS (legacy, ESP-IDF < 6.x)"
        default y
        select FREERTOS_ENABLE_BACKWARD_COMPATIBILITY
        help
            Legacy option for ESP-IDF releases where esp-tls offered wolfSSL as a built-in
            SSL library choice. From ESP-IDF 6.x onwards this option has no effect; use
            CONFIG_ESP_TLS_CUSTOM_STACK instead (esp-wolfssl then registers itself as the
            custom TLS stack automatically). Kept for sdkconfig compatibility.

    config WOLFSSL_HAVE_ALPN
        bool "Enable ALPN (Application Layer Protocol Negotiation) in wolfSSL"
        default y

    config WOLFSSL_HAVE_OCSP
        bool "Enable OCSP (Online Certificate Status Protocol) in wolfSSL"
        default n
        help
            Enables Online Certificate Status Protocol (OCSP) within wolfSSL, which is the modern alternative
            to maintaining Certificate Revocation Lists (CRLs). Enabling this option will make esp-tls to automatically
            indicate support for OCSP when connecting as a TLS client. Server that support OCSP will forward the
            certificate's revocation status to the client and the client will automatically verify the servers certificate
            status based on the OCSP response forwarded to it.
            Note: This option enables the OCSP in stapling (v1) mode for the client hence the TLS server needs to support OCSP stapling v1 .

    config WOLFSSL_HAVE_PQC
        bool "Enable Post-Quantum Cryptography (ML-KEM, ML-DSA, SHA-3/SHAKE)"
        default n
        help
            Enables native wolfSSL implementations of ML-KEM (formerly Kyber,
            security levels 512/768/1024), ML-DSA (formerly Dilithium, levels
            2/3/5) and the SHA-3/SHAKE hash functions they depend on.

            Note: enabling this adds roughly 30 kB of flash even if the
            application never uses a PQC algorithm, because the certificate
            parsing code references the PQC verify routines once they are
            compiled in. PQC algorithms also have noticeably larger memory
            requirements than classical crypto; consider increasing the task
            stack sizes when using them.

    config WOLFSSL_CERTIFICATE_BUNDLE
        bool "Enable trusted root certificate bundle (wolfSSL)"
        default n
        depends on !MBEDTLS_CERTIFICATE_BUNDLE
        help
            Enable support for a bundle of trusted root certificates, attached
            via esp_tls_cfg_t.crt_bundle_attach = esp_crt_bundle_attach. This is
            the wolfSSL equivalent of CONFIG_MBEDTLS_CERTIFICATE_BUNDLE: the
            common root CAs are embedded in the app so TLS servers can be
            verified without supplying a CA certificate per connection.

            Mutually exclusive with CONFIG_MBEDTLS_CERTIFICATE_BUNDLE (wolfSSL
            forbids enabling both); disable the mbedTLS bundle to use this one.

    choice WOLFSSL_CERTIFICATE_BUNDLE_DEFAULT
        prompt "Default certificate bundle options"
        depends on WOLFSSL_CERTIFICATE_BUNDLE
        default WOLFSSL_CERTIFICATE_BUNDLE_DEFAULT_FULL
        help
            Choose which certificates to embed in the default bundle.

        config WOLFSSL_CERTIFICATE_BUNDLE_DEFAULT_FULL
            bool "Use the full default certificate bundle"
        config WOLFSSL_CERTIFICATE_BUNDLE_DEFAULT_NONE
            bool "Do not use the default certificate bundle"
    endchoice

    config WOLFSSL_CERTIFICATE_BUNDLE_MAX_CERTS
        int "Maximum number of certificates in the certificate bundle"
        depends on WOLFSSL_CERTIFICATE_BUNDLE
        default 200

    config WOLFSSL_DEBUG_CERT_BUNDLE
        bool "Enable certificate bundle debug logging"
        depends on WOLFSSL_CERTIFICATE_BUNDLE
        default n

endmenu # wolfSSL
```

## examples/https_request/sdkconfig.defaults
```kconfig
CONFIG_ESP_TLS_CUSTOM_STACK=y
CONFIG_PARTITION_TABLE_SINGLE_APP_LARGE=y
CONFIG_LWIP_SNTP_MAX_SERVERS=2
```

## examples/wolfssl_client/main/Kconfig.projbuild
```kconfig
menu "Example Configuration"

    config EXAMPLE_SERVER_CERT_VERIFY
        bool      "Enable Server Certificate Verification"
        default   y
        help
	          Enabling this option validates the server certificate while establishing a TLS connection.

endmenu # Example Configuration
```
